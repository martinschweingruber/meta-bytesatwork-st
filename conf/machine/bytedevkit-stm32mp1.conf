## conf/machine/bytedevkit-stm32mp1.conf
```bitbake
# Copyright (C) 2022 bytes at work AG - https://www.bytesatwork.io
# Released under the MIT license (see COPYING.MIT for the terms)

#@TYPE: Machine
#@NAME: byteDEVKIT
#@DESCRIPTION: byteDEVKIT by bytes at work AG

require include/byteengine-stm32mp1.inc

MACHINE_FEATURES_remove = "fip"
MACHINE_FEATURES_remove = "optee"

# Don't build tfa and optee as we don't use secure-boot at the moment
EXTRA_IMAGEDEPENDS_remove = "tf-a-stm32mp"
EXTRA_IMAGEDEPENDS_remove = "optee-os-stm32mp"

EXTRA_IMAGEDEPENDS_remove = "virtual/trusted-firmware-a-serialboot"
FLASHLAYOUT_DEPEND_TASKS_remove = "virtual/trusted-firmware-a-serialboot"
EXTRA_IMAGEDEPENDS_remove = "virtual/trusted-firmware-a"
FLASHLAYOUT_DEPEND_TASKS_remove = "virtual/trusted-firmware-a"
EXTRA_IMAGEDEPENDS_remove = "virtual/optee-os"
FLASHLAYOUT_DEPEND_TASKS_remove = "virtual/optee-os"

# Do not remove any partitions from rootfs (/boot is needed for rauc)
PARTITIONS_MOUNTPOINT_IMAGE_remove = "${STM32MP_BOOTFS_MOUNTPOINT_IMAGE}"
PARTITIONS_MOUNTPOINT_IMAGE_remove = "${STM32MP_USERFS_MOUNTPOINT_IMAGE}"
PARTITIONS_MOUNTPOINT_IMAGE_remove = "${STM32MP_VENDORFS_MOUNTPOINT_IMAGE}"

IMAGE_FSTYPES_remove = "stmultiubi"

MACHINE_ESSENTIAL_EXTRA_RDEPENDS = "kernel-imagebootfs"

UBOOT_CONFIG = "basic 1g_ram"
UBOOT_CONFIG[basic] = "stm32mp157_bytedevkit_defconfig,,u-boot.img"
UBOOT_CONFIG[1g_ram] = "stm32mp157_bytedevkit_1g_defconfig,,u-boot.img"
UBOOT_DEVICETREE = "stm32mp157c-bytedevkit"

STM32MP_DEVICETREE = "stm32mp157c-bytedevkit"
```

## conf/machine/bytedevkit.conf
```bitbake
# Copyright (C) 2019 Oliver Stäbler <oliver.staebler@bytesatwork.ch>
# Released under the MIT license (see COPYING.MIT for the terms)

#@TYPE: Machine
#@NAME: byteDEVKIT
#@DESCRIPTION: byteDEVKIT by bytes at work AG

include conf/machine/include/st-machine-common-stm32mp.inc

DEFAULTTUNE = "cortexa7thf-neon-vfpv4"
include conf/machine/include/tune-cortexa7.inc

PREFERRED_PROVIDER_virtual/bootloader = "u-boot-stm32mp"

STM32MP_DEVICETREE = "stm32mp157c-bytedevkit"
ST_KERNEL_LOADADDR = "0xC2000040"
UBOOT_CONFIG = "basic"
UBOOT_CONFIG[basic] = "stm32mp157_bytedevkit_defconfig,,u-boot.img"

# flashlayout configuration
ENABLE_FLASHLAYOUT_DEFAULT = "1"
FLASHLAYOUT_DEFAULT_SRC = "files/flashlayouts/FlashLayout_sdcard_stm32mp157c-bytedevkit.tsv"
FLASHLAYOUT_CONFIG_LABELS += "sdcard"

# Necessary configuration for uboot-extlinux-config.bbclass
UBOOT_EXTLINUX_LABELS = "stm32mp157c-bytedevkit"
UBOOT_EXTLINUX_TARGETS = "stm32mp157c-bytedevkit"
UBOOT_EXTLINUX_ROOT = "root=/dev/mmcblk0p5"
UBOOT_EXTLINUX_DEFAULT_LABEL = "stm32mp157c-bytedevkit-sdcard"
UBOOT_EXTLINUX_FDT = "/stm32mp157c-bytedevkit.dtb"
#
# Don't build tfa and optee as we don't use secure-boot at the moment
EXTRA_IMAGEDEPENDS_remove = "tf-a-stm32mp"
EXTRA_IMAGEDEPENDS_remove = "optee-os-stm32mp"
```

## wic/stm32mp1-1g_ram.wks
```
# short-description: Create SD card image for stm32mp1
# long-description: Creates a partitioned SD card image for stm32mp1

part /fsbl1 --source rawcopy --sourceparams="file=bootloader/u-boot-spl.stm32-stm32mp157c-bytedevkit-v1-3-1g_ram" --ondisk mmcblk0 --part-name=fsbl1 --part-type=8301 --fixed-size 256K --align 17
part /fsbl2 --source rawcopy --sourceparams="file=bootloader/u-boot-spl.stm32-stm32mp157c-bytedevkit-v1-3-1g_ram" --ondisk mmcblk0 --part-name=fsbl2 --part-type=8301 --fixed-size 256K
part /ssbl  --source rawcopy --sourceparams="file=bootloader/u-boot-stm32mp157c-bytedevkit-v1-3-1g_ram.img" --ondisk mmcblk0 --part-name=ssbl --part-type=8301 --fixed-size 2048K
part /      --source rootfs --ondisk mmcblk0 --fstype=ext4 --label root --align 4096 --size 2G

bootloader --ptable gpt
```

## wic/stm32mp1.wks
```
# short-description: Create SD card image for stm32mp1
# long-description: Creates a partitioned SD card image for stm32mp1

part /fsbl1 --source rawcopy --sourceparams="file=bootloader/u-boot-spl.stm32-stm32mp157c-bytedevkit-basic" --ondisk mmcblk0 --part-name=fsbl1 --part-type=8301 --fixed-size 256K --align 17
part /fsbl2 --source rawcopy --sourceparams="file=bootloader/u-boot-spl.stm32-stm32mp157c-bytedevkit-basic" --ondisk mmcblk0 --part-name=fsbl2 --part-type=8301 --fixed-size 256K
part /ssbl  --source rawcopy --sourceparams="file=bootloader/u-boot-stm32mp157c-bytedevkit-basic.img" --ondisk mmcblk0 --part-name=ssbl --part-type=8301 --fixed-size 2048K
part /boot  --source bootimg-partition --ondisk mmcblk0 --fstype=ext4 --label boot --active --align 4 --size 64M --sourceparams="loader=u-boot"
part /      --source rootfs --ondisk mmcblk0 --fstype=ext4 --label root --align 4096 --size 2G

bootloader --ptable gpt
```
